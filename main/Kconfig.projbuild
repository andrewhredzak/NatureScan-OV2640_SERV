## main/Kconfig.projbuild
```kconfig
menu "Custom OV2640/SD/MMC  Configuration"

    config EXAMPLE_FORMAT_IF_MOUNT_FAILED
        bool "Format the card if mount failed"
        default n
        help
            If this config item is set, format_if_mount_failed will be set to true and the card will be formatted if
            the mount has failed.

    config EXAMPLE_FORMAT_SD_CARD
        bool "Format the card as a part of the example"
        default n
        help
            If this config item is set, the card will be formatted as a part of the example.

    choice EXAMPLE_SDMMC_BUS_WIDTH
        prompt "SD/MMC bus width"
        default EXAMPLE_SDMMC_BUS_WIDTH_4
        help
            Select the bus width of SD or MMC interface.
            Note that even if 1 line mode is used, D3 pin of the SD card must have a pull-up resistor connected.
            Otherwise the card may enter SPI mode, the only way to recover from which is to cycle power to the card.

        config EXAMPLE_SDMMC_BUS_WIDTH_4
            bool "4 lines (D0 - D3)"

        config EXAMPLE_SDMMC_BUS_WIDTH_1
            bool "1 line (D0)"
    endchoice

    if SOC_SDMMC_USE_GPIO_MATRIX

        config EXAMPLE_PIN_CMD
            int "CMD GPIO number"
            default 35 if IDF_TARGET_ESP32S3
            default 44 if IDF_TARGET_ESP32P4

        config EXAMPLE_PIN_CLK
            int "CLK GPIO number"
            default 36 if IDF_TARGET_ESP32S3
            default 43 if IDF_TARGET_ESP32P4

        config EXAMPLE_PIN_D0
            int "D0 GPIO number"
            default 37 if IDF_TARGET_ESP32S3
            default 39 if IDF_TARGET_ESP32P4

        if EXAMPLE_SDMMC_BUS_WIDTH_4

            config EXAMPLE_PIN_D1
                int "D1 GPIO number"
                default 38 if IDF_TARGET_ESP32S3
                default 40 if IDF_TARGET_ESP32P4

            config EXAMPLE_PIN_D2
                int "D2 GPIO number"
                default 33 if IDF_TARGET_ESP32S3
                default 41 if IDF_TARGET_ESP32P4

            config EXAMPLE_PIN_D3
                int "D3 GPIO number"
                default 34 if IDF_TARGET_ESP32S3
                default 42 if IDF_TARGET_ESP32P4

        endif  # EXAMPLE_SDMMC_BUS_WIDTH_4

    endif  # SOC_SDMMC_USE_GPIO_MATRIX

    config EXAMPLE_DEBUG_PIN_CONNECTIONS
        bool "Debug sd pin connections and pullup strength"
        default n

    if !SOC_SDMMC_USE_GPIO_MATRIX
        config EXAMPLE_PIN_CMD
            depends on EXAMPLE_DEBUG_PIN_CONNECTIONS
            default 15 if IDF_TARGET_ESP32

        config EXAMPLE_PIN_CLK
            depends on EXAMPLE_DEBUG_PIN_CONNECTIONS
            default 14 if IDF_TARGET_ESP32

        config EXAMPLE_PIN_D0
            depends on EXAMPLE_DEBUG_PIN_CONNECTIONS
            default 2 if IDF_TARGET_ESP32

        if EXAMPLE_SDMMC_BUS_WIDTH_4

            config EXAMPLE_PIN_D1
                depends on EXAMPLE_DEBUG_PIN_CONNECTIONS
                default 4 if IDF_TARGET_ESP32

            config EXAMPLE_PIN_D2
                depends on EXAMPLE_DEBUG_PIN_CONNECTIONS
                default 12 if IDF_TARGET_ESP32

            config EXAMPLE_PIN_D3
                depends on EXAMPLE_DEBUG_PIN_CONNECTIONS
                default 13 if IDF_TARGET_ESP32

        endif  # EXAMPLE_SDMMC_BUS_WIDTH_4
    endif

    config EXAMPLE_ENABLE_ADC_FEATURE
        bool "Enable ADC feature"
        depends on EXAMPLE_DEBUG_PIN_CONNECTIONS
        default y if IDF_TARGET_ESP32
        default n

    config EXAMPLE_ADC_UNIT
        int "ADC Unit"
        depends on EXAMPLE_ENABLE_ADC_FEATURE
        default 1 if IDF_TARGET_ESP32
        default 1

    config EXAMPLE_ADC_PIN_CLK
        int "CLK mapped ADC pin"
        depends on EXAMPLE_ENABLE_ADC_FEATURE
        default 6 if IDF_TARGET_ESP32
        default 1

    config EXAMPLE_ADC_PIN_CMD
        int "CMD mapped ADC pin"
        depends on EXAMPLE_ENABLE_ADC_FEATURE
        default 3 if IDF_TARGET_ESP32
        default 1

    config EXAMPLE_ADC_PIN_D0
        int "D0 mapped ADC pin"
        depends on EXAMPLE_ENABLE_ADC_FEATURE
        default 2 if IDF_TARGET_ESP32
        default 1

    if EXAMPLE_SDMMC_BUS_WIDTH_4

        config EXAMPLE_ADC_PIN_D1
            int "D1 mapped ADC pin"
            depends on EXAMPLE_ENABLE_ADC_FEATURE
            default 0 if IDF_TARGET_ESP32
            default 1

        config EXAMPLE_ADC_PIN_D2
            int "D2 mapped ADC pin"
            depends on EXAMPLE_ENABLE_ADC_FEATURE
            default 5 if IDF_TARGET_ESP32
            default 1

        config EXAMPLE_ADC_PIN_D3
            int "D3 mapped ADC pin"
            depends on EXAMPLE_ENABLE_ADC_FEATURE
            default 4 if IDF_TARGET_ESP32
            default 1

    endif  # EXAMPLE_SDMMC_BUS_WIDTH_4

    config EXAMPLE_SD_PWR_CTRL_LDO_INTERNAL_IO
        depends on SOC_SDMMC_IO_POWER_EXTERNAL
        bool "SD power supply comes from internal LDO IO (READ HELP!)"
        default y
        help
            Only needed when the SD card is connected to specific IO pins which can be used for high-speed SDMMC.
            Please read the schematic first and check if the SD VDD is connected to any internal LDO output.
            Unselect this option if the SD card is powered by an external power supply.

    config EXAMPLE_SD_PWR_CTRL_LDO_IO_ID
        depends on SOC_SDMMC_IO_POWER_EXTERNAL && EXAMPLE_SD_PWR_CTRL_LDO_INTERNAL_IO
        int "LDO ID"
        default 4 if IDF_TARGET_ESP32P4
        help
            Please read the schematic first and input your LDO ID.


    choice ESPNOW_WIFI_MODE
        prompt "WiFi mode"
        default ESPNOW_WIFI_MODE_STATION
        help
            WiFi mode(station or softap).

        config ESPNOW_WIFI_MODE_STATION
            bool "Station"
        config ESPNOW_WIFI_MODE_STATION_SOFTAP
            bool "Softap"
    endchoice

    config ESPNOW_PMK
        string "ESPNOW primary master key"
        default "pmk1234567890123"
        help
            ESPNOW primary master for the example to use. The length of ESPNOW primary master must be 16 bytes.

    config ESPNOW_LMK
        string "ESPNOW local master key"
        default "lmk1234567890123"
        help
            ESPNOW local master for the example to use. The length of ESPNOW local master must be 16 bytes.

    config ESPNOW_CHANNEL
        int "Channel"
        default 1
        range 0 14
        help
            The channel on which sending and receiving ESPNOW data.

    config ESPNOW_SEND_COUNT
        int "Send count"
        default 100
        range 1 65535
        help
            Total count of unicast ESPNOW data to be sent.

    config ESPNOW_SEND_DELAY
        int "Send delay"
        default 1000
        range 0 65535
        help
            Delay between sending two ESPNOW data, unit: ms.

    config ESPNOW_SEND_LEN
        int "Send len"
        range 10 250
        default 10
        help
            Length of ESPNOW data to be sent, unit: byte.

    config ESPNOW_ENABLE_LONG_RANGE
        bool "Enable Long Range"
        default "n"
        help
            When enable long range, the PHY rate of ESP32 will be 512Kbps or 256Kbps

    config ESPNOW_ENABLE_POWER_SAVE
        bool "Enable ESPNOW Power Save"
        default "n"
        select ESP_WIFI_STA_DISCONNECTED_PM_ENABLE
        depends on ESPNOW_WIFI_MODE_STATION
        help
            With ESPNOW power save enabled, chip would be able to wakeup and sleep periodically
            Notice ESP_WIFI_STA_DISCONNECTED_PM_ENABLE is essential at Wi-Fi disconnected

    config ESPNOW_WAKE_WINDOW
        int "ESPNOW wake window, unit in millisecond"
        range 0 65535
        default 50
        depends on ESPNOW_ENABLE_POWER_SAVE
        help
            ESPNOW wake window

    config ESPNOW_WAKE_INTERVAL
        int "ESPNOW wake interval, unit in millisecond"
        range 1 65535
        default 100
        depends on ESPNOW_ENABLE_POWER_SAVE
        help
            ESPNOW wake interval



endmenu
```
